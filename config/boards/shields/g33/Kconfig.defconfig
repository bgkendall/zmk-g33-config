## config/boards/shields/g33/Kconfig.defconfig
```kconfig
if SHIELD_G33

config ZMK_KEYBOARD_NAME
    default "Gherkin+3"

endif


if ZMK_BACKLIGHT

config PWM
    default y

config LED_PWM
    default y

endif # ZMK_BACKLIGHT
```
